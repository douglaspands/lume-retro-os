// SPDX-License-Identifier: GPL-2.0
/*
 * GA36-MB V1.2 (Allwinner A33), painel 2: JD9366 com a sequência
 * jd9366_panel_2_init_sequence do goodluckOS (não verificada contra um firmware
 * de fábrica).
 */

/dts-v1/;
#include "sun8i-a33-ga36-mb-v1.2.dtsi"

/ {
	model = "GA36-MB V1.2 (painel 2)";
	compatible = "ga36mb,ga36-mb-v1.2", "allwinner,sun8i-a33";

	/*
	 * DTB selection (boot-dtb-select D3): no rules until a measured signature tells the
	 * two panels apart, so it is chosen only from the list or BOOT/dtbs/force
	 */
	lume-select {
		lume,id = "ga36-panel2";
		lume,priority = <0>;
	};
};

&panel {
	compatible = "ga36mb,jd9366-panel2";
};
